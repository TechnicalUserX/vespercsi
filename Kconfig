## Kconfig
```kconfig
mainmenu "VesperCSI Configuration"

    menu "Compiler"

        menuconfig VESPERCSI_COMPILER_GLOBAL
            bool "Set Global settings"
            default n

            config VESPERCSI_COMPILER_GLOBAL_CC
                string "CC"
                default "gcc"
                depends on VESPERCSI_COMPILER_GLOBAL
        
            config VESPERCSI_COMPILER_GLOBAL_CFLAGS
                string "CFLAGS"
                default ""
                depends on VESPERCSI_COMPILER_GLOBAL

            config VESPERCSI_COMPILER_GLOBAL_CPPFLAGS
                string "CPPFLAGS"
                default ""
                depends on VESPERCSI_COMPILER_GLOBAL

            config VESPERCSI_COMPILER_GLOBAL_CXX
                string "CXX"
                default "g++"
                depends on VESPERCSI_COMPILER_GLOBAL

            config VESPERCSI_COMPILER_GLOBAL_CXXFLAGS
                string "CXXFLAGS"
                default ""
                depends on VESPERCSI_COMPILER_GLOBAL

            config VESPERCSI_COMPILER_GLOBAL_LDFLAGS
                string "LDFLAGS"
                default ""
                depends on VESPERCSI_COMPILER_GLOBAL

    endmenu

    menu "Channel State Information"

        menuconfig VESPERCSI_CSI_LIMITS
            bool "Set Internal Limits"
            default n

            config VESPERCSI_CSI_SUPPORTED_TX_MAX
                int "Maximum Supported TX Count"
                default 1
                depends on VESPERCSI_CSI_LIMITS

            config VESPERCSI_CSI_SUPPORTED_RX_MAX
                int "Maximum Supported RX Count"
                default 1
                depends on VESPERCSI_CSI_LIMITS

            config VESPERCSI_CSI_SUPPORTED_SUBCARRIERS_MAX
                int "Maximum Supported Subcarriers"
                default 56
                depends on VESPERCSI_CSI_LIMITS

            config VESPERCSI_CSI_SUPPORTED_TIME_FRAME_MAX
                int "Maximum Supported CSI Capture Time Frame"
                default 3
                depends on VESPERCSI_CSI_LIMITS

            config VESPERCSI_CSI_SUPPORTED_RATE_MAX
                int "Maximum Supported CSI Capture Per Second"
                default 100
                depends on VESPERCSI_CSI_LIMITS

    endmenu

    menu "Wireless"

        menuconfig VESPERCSI_WIFI
            bool "Override Interface Defaults"
            default n

            config VESPERCSI_WIFI_INTERFACE
                string "Monitor Mode Interface Name"
                default "vespercsimon"
                depends on VESPERCSI_WIFI

            config VESPERCSI_WIFI_INTERFACE_MAX_SIZE
                int "Maximum number of interfaces enumerable"
                default 10
                depends on VESPERCSI_WIFI

            config VESPERCSI_WIFI_PHY_MAX_SIZE
                int "Maximum number of phys enumerable"
                default 10
                depends on VESPERCSI_WIFI

    endmenu

    menu "Plugin System"

        menuconfig VESPERCSI_PLUGINS
            bool "Override Plugin System Defaults"
            default n

        config VESPERCSI_PLUGIN_FOLDER
            string "Directory to search for plugins"
            default "/etc/vespercsi/plugins"
            depends on VESPERCSI_PLUGINS

        source "plugins/Kconfig"
    
    endmenu
```

## plugins/Kconfig
```kconfig
# Plugin Configurations

menu "Configure Plugins"
    source "plugins/ir_label/Kconfig"
    source "plugins/livestd/Kconfig"
endmenu
```

## plugins/ir_label/Kconfig
```kconfig
menuconfig VESPERCSI_PLUGIN_IR_LABEL
    bool "Infrared Labeling"
    default n

    config VESPERCSI_PLUGIN_IR_LABEL_LIRC
        bool "Linux Infrared Remote Control (LIRC) Setup"
        default n
        depends on VESPERCSI_PLUGIN_IR_LABEL

    if VESPERCSI_PLUGIN_IR_LABEL_LIRC

        config VESPERCSI_PLUGIN_IR_LABEL_LIRC_DEV
            string "Path for infrared device"
            default "/dev/lirc0"

    endif

    config VESPERCSI_PLUGIN_IR_LABEL_GPIO
        bool "GPIO Setup"
        default n
        depends on VESPERCSI_PLUGIN_IR_LABEL

    if VESPERCSI_PLUGIN_IR_LABEL_GPIO

        config VESPERCSI_PLUGIN_IR_LABEL_GPIO_DEV
            string "Path for GPIO device"
            default "/dev/gpiochip0"

        config VESPERCSI_PLUGIN_IR_LABEL_GPIO_LINE_LED_RED
            int "Red LED pin number"
            default 27

        config VESPERCSI_PLUGIN_IR_LABEL_GPIO_LINE_BUZZER
            int "Buzzer pin number"
            default 22

    endif


    config VESPERCSI_PLUGIN_IR_LABEL_COMMANDS
        bool "Command Value Assignment"
        default n
        depends on VESPERCSI_PLUGIN_IR_LABEL

    if VESPERCSI_PLUGIN_IR_LABEL_COMMANDS

        config VESPERCSI_PLUGIN_IR_LABEL_COMMAND_START_CAPTURE
            hex "Start Capture"
            default 0x00

        config VESPERCSI_PLUGIN_IR_LABEL_COMMAND_STOP_CAPTURE
            hex "Stop Capture"
            default 0x01           

        config VESPERCSI_PLUGIN_IR_LABEL_COMMAND_DISCARD_CAPTURE
            hex "Discard Capture"
            default 0x02                

        config VESPERCSI_PLUGIN_IR_LABEL_COMMAND_SET_ACTION_WALK
            hex "Set current action to walk"
            default 0x03  

        config VESPERCSI_PLUGIN_IR_LABEL_COMMAND_SET_ACTION_RUN
            hex "Set current action to run"
            default 0x04 

        config VESPERCSI_PLUGIN_IR_LABEL_COMMAND_SET_ACTION_JUMP
            hex "Set current action to jump"
            default 0x05

        config VESPERCSI_PLUGIN_IR_LABEL_COMMAND_SET_ACTION_STILL
            hex "Set current action to still"
            default 0x06

        config VESPERCSI_PLUGIN_IR_LABEL_COMMAND_SET_ACTION_STANDUP
            hex "Set current action to stand up"
            default 0x07

        config VESPERCSI_PLUGIN_IR_LABEL_COMMAND_SET_ACTION_SITDOWN
            hex "Set current action to sit down"
            default 0x08

        config VESPERCSI_PLUGIN_IR_LABEL_COMMAND_SET_ACTION_SITSTAND
            hex "Set current action to sit-stand rapid mode"
            default 0x09

        config VESPERCSI_PLUGIN_IR_LABEL_COMMAND_SET_ACTION_FALL
            hex "Set current action to fall"
            default 0x10

        config VESPERCSI_PLUGIN_IR_LABEL_COMMAND_SET_ACTION_EMPTY
            hex "Set current action to empty"
            default 0x11

        config VESPERCSI_PLUGIN_IR_LABEL_COMMAND_CAPTURE_INDEX_INCREASE
            hex "Increase capture index (affects record file naming)"
            default 0x12

        config VESPERCSI_PLUGIN_IR_LABEL_COMMAND_CAPTURE_INDEX_DECREASE
            hex "Decrease capture index (affects record file naming)"
            default 0x13            

        config VESPERCSI_PLUGIN_IR_LABEL_COMMAND_CAPTURE_INDEX_TOGGLE_AUTOINCREMENT
            hex "Toggle capture index auto increment (affects record file naming)"
            default 0x14

    endif

    config VESPERCSI_PLUGIN_IR_LABEL_ACTIONS
        bool "Actions"
        default n
        depends on VESPERCSI_PLUGIN_IR_LABEL

    if VESPERCSI_PLUGIN_IR_LABEL_ACTIONS

        config VESPERCSI_PLUGIN_IR_LABEL_ACTION_POLICY_PERIODIC_DEFAULT_DURATION
            int "Default duration for each action in periodic mode"
            default 10000000

        config VESPERCSI_PLUGIN_IR_LABEL_ACTION_POLICY_PERIODIC_DEFAULT_WAIT
            int "Default wait time between captures in periodic mode"
            default 5000000

    endif

    
```

## plugins/livestd/Kconfig
```kconfig
menuconfig VESPERCSI_PLUGIN_LIVESTD
    bool "Live CSI Standard Deviation Graph"
    default n


    config VESPERCSI_PLUGIN_LIVESTD_FIXED_Y_MAX
        int "Vertical Standard Deviation Length"
        default 16
        depends on VESPERCSI_PLUGIN_LIVESTD
```
